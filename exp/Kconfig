## exp/Kconfig
```kconfig
mainmenu "PSA Crypto API"

choice
     prompt "Operating System"

config OS_POSIX
     bool "POSIX-like (Linux/BSD/Mac)"

config OS_MBEDOS
     bool "Mbed OS"

endchoice

menuconfig HASH_ALGORITHMS
    bool "Support hash / message digests"
    default y

if HASH_ALGORITHMS
    config SHA2
        bool "Support SHA2 Algorithm"
        default y
endif

config HAVE_SHA2_256
    bool

source "alt/Kconfig"
```

## exp/alt/Kconfig
```kconfig
source "alt/arm/mbedtls/Kconfig"
source "alt/intel/tinycrypt/Kconfig"
source "alt/vendor/accel/Kconfig"
```

## exp/alt/arm/mbedtls/Kconfig
```kconfig
menuconfig ARM_MBEDTLS
    bool "Enable Arm MbedTLS implementation"

if ARM_MBEDTLS
    config ARM_MBEDTLS_SHA2_256
        bool "Use arm/mbedtls SHA-256 implementation"
        depends on SHA2 || SHA2_256
        select HAVE_SHA2_256
        default n
endif
```

## exp/alt/intel/tinycrypt/Kconfig
```kconfig
menuconfig INTEL_TINYCRYPT
    bool "Enable tinycrypt implementation"

if INTEL_TINYCRYPT
    config INTEL_TINYCRYPT_SHA2_256
        bool "Use tinycrypt SHA-256 implementation"
        depends on SHA2 || SHA2_256
        default n
        select HAVE_SHA2_256
endif
```

## exp/alt/vendor/accel/Kconfig
```kconfig
menuconfig VENDOR_ACCEL
    bool "Enable Vendor Accel implementation"

if VENDOR_ACCEL
    config VENDOR_ACCEL_SHA2_256
        bool "Use vendor/accel SHA-256 implementation"
        depends on SHA2 || SHA2_256
        default n
        select HAVE_SHA2_256
endif
```
